/*
 * SPDX-License-Identifier: MIT
 * Copyright (c) 2026 Phenix-1255 contributors
 */

#include <string.h>

#include <zephyr/sys/util.h>

#include "display/display_fb.h"

#define FONT_FIRST 0x20
#define FONT_LAST  0x7E
#define GLYPH_COLS 5

/* Printable ASCII, one byte per column, bit 0 = top row, bit 7 unused */
static const uint8_t font5x7[FONT_LAST - FONT_FIRST + 1][GLYPH_COLS] = {
	{0x00, 0x00, 0x00, 0x00, 0x00}, /* ' ' */
	{0x00, 0x00, 0x5F, 0x00, 0x00}, /* '!' */
	{0x00, 0x07, 0x00, 0x07, 0x00}, /* '"' */
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	{0x08, 0x04, 0x08, 0x10, 0x08}, /* '~' */
};

void fb_clear(uint8_t *fb)
{
	memset(fb, 0, FB_SIZE);
}

void fb_bitmap(uint8_t *fb, int x, int y, const struct fb_bitmap *bm)
{
	int stride = (bm->width + 7) / 8;

	for (int r = 0; r < bm->height; r++) {
		int py = y + r;

		if (py < 0 || py >= FB_HEIGHT) {
			continue;
		}
		for (int c = 0; c < bm->width; c++) {
			int px = x + c;

			if (px < 0 || px >= FB_WIDTH) {
				continue;
			}
			if (bm->bits[r * stride + c / 8] & BIT(7 - (c % 8))) {
				fb[(py / 8) * FB_WIDTH + px] |= BIT(py % 8);
			}
		}
	}
}

void fb_fill(uint8_t *fb, int row, int x0, int x1, bool on)
{
	if (row < 0 || row >= FB_ROWS) {
		return;
	}
	x0 = MAX(x0, 0);
	x1 = MIN(x1, FB_WIDTH);
	if (x1 > x0) {
		memset(&fb[row * FB_WIDTH + x0], on ? 0xFF : 0x00, x1 - x0);
	}
}

int fb_text(uint8_t *fb, int row, int x, const char *str, bool invert)
{
	uint8_t mask = invert ? 0xFF : 0x00;
	uint8_t *line;

	if (row < 0 || row >= FB_ROWS) {
		return x;
	}
	line = &fb[row * FB_WIDTH];

	for (; *str != '\0' && x < FB_WIDTH; str++) {
		unsigned char c = (unsigned char)*str;
		const uint8_t *glyph = font5x7[((c < FONT_FIRST || c > FONT_LAST) ? '?' : c) -
					       FONT_FIRST];

		for (int col = 0; col < FB_CHAR_WIDTH; col++, x++) {
			if (x < 0 || x >= FB_WIDTH) {
				continue;
			}
			line[x] = ((col < GLYPH_COLS) ? glyph[col] : 0x00) ^ mask;
		}
	}

	return x;
}

int fb_text_width(const char *str)
{
	return (int)strlen(str) * FB_CHAR_WIDTH;
}

int fb_chip(uint8_t *fb, int row, int x, const char *str)
{
	fb_fill(fb, row, x, x + 1, true);
	x = fb_text(fb, row, x + 1, str, true);
	/* The glyph spacing column already closes the label on the right */
	return x;
}

int fb_chip_width(const char *str)
{
	return fb_text_width(str) + 1;
}
